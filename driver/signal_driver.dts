/dts-v1/;
/plugin/;

 / {
    compatible = "brcm,bcm2835";

    fragment@0 {
        target-path = "/";  
        __overlay__ {
            signal_driver: signal_driver {
                compatible = "my,signal-driver";
                signal-gpios = <&gpio 17 0>, <&gpio 27 0>;
                status = "okay";
            };
        };
    };
};
